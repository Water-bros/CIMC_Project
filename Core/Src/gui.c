//
// Created by Water_bros on 2025-05-13.
//
#include "main.h"
#include "gui.h"

#define DISP_W 128
#define DISP_H 32

#define TILE_INDI_H 2
#define TILE_INDI_W 14
#define TILE_ICON_H 28
#define TILE_ICON_W 28
#define TILE_ICON_S 32

#define   LIST_TEXT_H         8
#define   LIST_LINE_H         16
#define   LIST_TEXT_S         4
#define   LIST_BAR_W          5

#define FONT u8g2_font_heisans_tr

uint32_t tick = 0;

const uint16_t KEY_Pins[6] = {KEY1_Pin, KEY2_Pin, KEY3_Pin, KEY4_Pin, KEY5_Pin, KEY6_Pin};
const uint16_t LED_Pins[6] = {LED1_Pin, LED2_Pin, LED3_Pin, LED4_Pin, LED5_Pin, LED6_Pin};

//region
const uint8_t main_icons[][20 * 7] = {
        {
                0xFF, 0xFF, 0xFF, 0x0F, 0xF7, 0xFF, 0xFF, 0x0F, 0xE3, 0xFF, 0xFF, 0x0F, 0xE3, 0xFF, 0xFF, 0x0F,
                0xC1, 0xFF, 0xFF, 0x0F, 0xF7, 0xF8, 0xFF, 0x0F, 0x37, 0xE0, 0xFF, 0x0F, 0x37, 0xE7, 0xFF, 0x0F,
                0x97, 0xCF, 0xFF, 0x0F, 0x97, 0xCF, 0xFF, 0x0F, 0xC7, 0x9F, 0xFF, 0x0F, 0xC7, 0x9F, 0xFF, 0x0F,
                0xE7, 0x3F, 0xFF, 0x0F, 0xE7, 0x3F, 0xFF, 0x0C, 0xF7, 0x7F, 0xFE, 0x0C, 0xF7, 0x7F, 0xFE, 0x0C,
                0xF7, 0xFF, 0x7C, 0x0E, 0xF7, 0xFF, 0x7C, 0x0E, 0xF7, 0xFF, 0x39, 0x0F, 0xF7, 0xFF, 0x01, 0x0F,
                0xF7, 0xFF, 0xC7, 0x0F, 0xF7, 0xFF, 0xFF, 0x0F, 0xF7, 0xFF, 0x7F, 0x0F, 0xF7, 0xFF, 0x7F, 0x0C,
                0x07, 0x00, 0x00, 0x08, 0xFF, 0xFF, 0x7F, 0x0C, 0xFF, 0xFF, 0x7F, 0x0F, 0xFF, 0xFF, 0xFF, 0x0F,
        },// ADC
        {
                0xff, 0xff, 0xff, 0x0f, 0xff, 0x0f, 0xff, 0x0f, 0xff, 0x03, 0xfc, 0x0f, 0xff, 0xf1, 0xf8, 0x0f,
                0xff, 0xfc, 0xf3, 0x0f, 0x7f, 0xfe, 0xe7, 0x0f, 0x7f, 0xfe, 0xe7, 0x0f, 0x7f, 0xfe, 0xe7, 0x0f,
                0x7f, 0xfe, 0xe7, 0x0f, 0x7f, 0xfe, 0xe7, 0x0f, 0x7f, 0xfe, 0xe7, 0x0f, 0x7f, 0xfc, 0xe3, 0x0f,
                0xff, 0xfc, 0xf3, 0x0f, 0xff, 0xfc, 0xf3, 0x0f, 0xff, 0xf9, 0xf9, 0x0f, 0xff, 0xf9, 0xf9, 0x0f,
                0xff, 0xf3, 0xfc, 0x0f, 0xff, 0x93, 0xfc, 0x0f, 0xff, 0x93, 0xfc, 0x0f, 0xff, 0x93, 0xfc, 0x0f,
                0xff, 0x03, 0xfc, 0x0f, 0xff, 0x07, 0xfe, 0x0f, 0xff, 0xff, 0xff, 0x0f, 0xff, 0x07, 0xfe, 0x0f,
                0xff, 0x07, 0xfe, 0x0f, 0xff, 0xff, 0xff, 0x0f, 0xff, 0x9f, 0xff, 0x0f, 0xff, 0xff, 0xff, 0x0f,
        },// LED
        {
                0xff, 0xff, 0xff, 0x0f, 0xff, 0x03, 0xfc, 0x0f, 0xff, 0x00, 0xf0, 0x0f, 0x3f, 0x00, 0xc0, 0x0f,
                0x1f, 0xf8, 0x81, 0x0f, 0x0f, 0xfe, 0x07, 0x0f, 0x87, 0xcf, 0x1f, 0x0e, 0xc7, 0xcf, 0x3f, 0x0e,
                0xc3, 0xcf, 0x3f, 0x0c, 0xe3, 0xcf, 0x7f, 0x0c, 0xe1, 0xcf, 0x7f, 0x08, 0xf1, 0xcf, 0xff, 0x08,
                0xf1, 0xcf, 0xff, 0x08, 0xf1, 0x0f, 0xf0, 0x08, 0xf1, 0x0f, 0xf0, 0x08, 0xf1, 0x1f, 0xf0, 0x08,
                0xf1, 0xff, 0xff, 0x08, 0xe1, 0xff, 0x7f, 0x08, 0xe3, 0xff, 0x7f, 0x0c, 0xc3, 0xff, 0x3f, 0x0c,
                0x87, 0xff, 0x3f, 0x0e, 0x87, 0xff, 0x1f, 0x0e, 0x0f, 0xfe, 0x07, 0x0f, 0x1f, 0xf8, 0x81, 0x0f,
                0x3f, 0x00, 0xc0, 0x0f, 0xff, 0x00, 0xf0, 0x0f, 0xff, 0x03, 0xfc, 0x0f, 0xff, 0xff, 0xff, 0x0f
        },// RTC
        {
                0xff, 0xff, 0xff, 0x0f, 0xff, 0xff, 0xff, 0x0f, 0xff, 0xff, 0xff, 0x0f, 0x03, 0xff, 0xff, 0x0f,
                0x7d, 0xfe, 0xff, 0x0f, 0xfd, 0x01, 0x00, 0x0f, 0xfd, 0xff, 0x7f, 0x0e, 0xfd, 0xff, 0x7f, 0x0e,
                0xfd, 0xff, 0x7f, 0x0e, 0x0d, 0x00, 0x00, 0x08, 0xed, 0xff, 0xff, 0x0b, 0xed, 0xff, 0xff, 0x0b,
                0xed, 0xff, 0xff, 0x0b, 0xed, 0xff, 0xff, 0x0b, 0xed, 0xff, 0xff, 0x0b, 0xed, 0xff, 0xff, 0x0b,
                0xed, 0xff, 0xff, 0x0b, 0xed, 0xff, 0xff, 0x0b, 0xed, 0xff, 0xff, 0x0b, 0xed, 0xff, 0xff, 0x0b,
                0xed, 0xff, 0xff, 0x0b, 0xed, 0xff, 0xff, 0x0b, 0xed, 0xff, 0xff, 0x0b, 0xe1, 0xff, 0xff, 0x09,
                0x03, 0x00, 0x00, 0x0c, 0xff, 0xff, 0xff, 0x0f, 0xff, 0xff, 0xff, 0x0f, 0xff, 0xff, 0xff, 0x0f,
        },// FLASH
        {
                0xff, 0xff, 0xff, 0x0f, 0x7f, 0x00, 0x80, 0x0f, 0x3f, 0x78, 0x80, 0x0f, 0x9f, 0xff, 0xbf, 0x0f,
                0xef, 0xff, 0xbf, 0x0f, 0xef, 0xff, 0xbf, 0x0f, 0x6f, 0x00, 0x80, 0x0f, 0x6f, 0x00, 0x80, 0x0f,
                0x0f, 0x00, 0x80, 0x0f, 0x1f, 0x00, 0x00, 0x0f, 0x1f, 0x00, 0xc0, 0x0f, 0x0f, 0x00, 0xc0, 0x0f,
                0x0f, 0x00, 0x80, 0x0f, 0x0f, 0x00, 0x80, 0x0f, 0x0f, 0x00, 0x80, 0x0f, 0x0f, 0x00, 0x80, 0x0f,
                0x0f, 0x00, 0x80, 0x0f, 0x0f, 0x00, 0x80, 0x0f, 0x0f, 0x00, 0x80, 0x0f, 0x0f, 0x00, 0x80, 0x0f,
                0x0f, 0x00, 0x80, 0x0f, 0x0f, 0x00, 0x80, 0x0f, 0x0f, 0x00, 0x80, 0x0f, 0x0f, 0x00, 0x80, 0x0f,
                0x0f, 0x00, 0x80, 0x0f, 0x0f, 0x00, 0x80, 0x0f, 0x1f, 0x00, 0x80, 0x0f, 0xff, 0xff, 0xff, 0x0f,
        },// TF
        {
                0xff, 0xff, 0xff, 0x0f, 0x01, 0x00, 0x00, 0x08, 0x01, 0x00, 0x00, 0x08, 0x01, 0x00, 0x00, 0x08,
                0x01, 0x00, 0x00, 0x08, 0x01, 0xf0, 0x00, 0x08, 0x01, 0xf0, 0x00, 0x08, 0x01, 0xf0, 0x00, 0x08,
                0x01, 0xf0, 0x00, 0x08, 0x01, 0x00, 0x00, 0x08, 0x01, 0x00, 0x00, 0x08, 0x01, 0x00, 0x00, 0x08,
                0x01, 0xfc, 0x00, 0x08, 0x01, 0xf8, 0x00, 0x08, 0x01, 0xf8, 0x00, 0x08, 0x01, 0xf0, 0x00, 0x08,
                0x01, 0xf0, 0x00, 0x08, 0x01, 0xf0, 0x00, 0x08, 0x01, 0xf0, 0x00, 0x08, 0x01, 0xf8, 0x01, 0x08,
                0x01, 0xfc, 0x07, 0x08, 0x01, 0xfc, 0x07, 0x08, 0x01, 0x00, 0x03, 0x08, 0x01, 0x00, 0x00, 0x08,
                0x01, 0x00, 0x00, 0x08, 0x01, 0x00, 0x00, 0x08, 0x01, 0x00, 0x00, 0x08, 0xff, 0xff, 0xff, 0x0f,
        },// INFO
        {
                0xFF, 0xFF, 0xFF, 0x0F, 0xFF, 0xFF, 0xFF, 0x0F, 0xFF, 0x9F, 0xFF, 0x0F, 0xFF, 0x0F, 0xFF, 0x0F,
                0xFF, 0x0F, 0xFF, 0x0F, 0x3F, 0x0F, 0xCF, 0x0F, 0x1F, 0x02, 0x84, 0x0F, 0x1F, 0x00, 0x80, 0x0F,
                0x3F, 0x00, 0xC0, 0x0F, 0x7F, 0x60, 0xE0, 0x0F, 0x3F, 0xF8, 0xC1, 0x0F, 0x3F, 0xFC, 0xC3, 0x0F,
                0x07, 0xFC, 0x03, 0x0E, 0x03, 0xFE, 0x07, 0x0C, 0x03, 0xFE, 0x07, 0x0C, 0x07, 0xFC, 0x03, 0x0E,
                0x3F, 0xFC, 0xC3, 0x0F, 0x3F, 0xF8, 0xC1, 0x0F, 0x7F, 0x60, 0xE0, 0x0F, 0x3F, 0x00, 0xC0, 0x0F,
                0x1F, 0x00, 0x80, 0x0F, 0x1F, 0x02, 0x84, 0x0F, 0x3F, 0x0F, 0xCF, 0x0F, 0xFF, 0x0F, 0xFF, 0x0F,
                0xFF, 0x0F, 0xFF, 0x0F, 0xFF, 0x9F, 0xFF, 0x0F, 0xFF, 0xFF, 0xFF, 0x0F, 0xFF, 0xFF, 0xFF, 0x0F,
        },// SETTING
        {
                0xff, 0xff, 0xff, 0x0f, 0xff, 0xff, 0xff, 0x0f, 0xff, 0xff, 0xff, 0x0f, 0xff, 0xff, 0xff, 0x0f,
                0xff, 0x83, 0xff, 0x0f, 0x7f, 0x0c, 0xc0, 0x0f, 0x7f, 0x7c, 0x06, 0x08, 0x1f, 0x7c, 0xce, 0x09,
                0x0f, 0x7c, 0xce, 0x09, 0x03, 0x7c, 0xce, 0x09, 0x01, 0x00, 0xce, 0x09, 0x41, 0x03, 0xc0, 0x09,
                0xc1, 0x3e, 0x00, 0x08, 0x79, 0x7c, 0x4e, 0x08, 0x0f, 0x7c, 0xce, 0x09, 0x03, 0x7c, 0xce, 0x09,
                0x01, 0x7c, 0xce, 0x09, 0x41, 0x02, 0xc8, 0x09, 0xe1, 0x07, 0x00, 0x08, 0x7f, 0x7c, 0xcf, 0x09,
                0x03, 0x7c, 0xcf, 0x0d, 0x01, 0x7c, 0xcf, 0x0d, 0x01, 0x7c, 0xcf, 0x0f, 0x41, 0x7c, 0xcf, 0x0f,
                0xff, 0xff, 0xff, 0x0f, 0xff, 0xff, 0xff, 0x0f, 0xff, 0xff, 0xff, 0x0f, 0xff, 0xff, 0xff, 0x0f,
        },// CUBE
};
//endregion
//region
const uint8_t genshin[512] = {
        0xff, 0xff, 0xff, 0xff, 0xff, 0xff, 0xff, 0xff, 0xff, 0xff, 0xff, 0xff, 0xff, 0xff, 0xff, 0xff,
        0xff, 0xff, 0xff, 0xff, 0xff, 0xff, 0xff, 0xff, 0xff, 0xff, 0xff, 0xf9, 0xff, 0xff, 0xff, 0xff,
        0xff, 0xff, 0xff, 0xff, 0xff, 0xff, 0xff, 0xff, 0xff, 0xff, 0xff, 0xf9, 0xff, 0xff, 0xff, 0xff,
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        0xff, 0xff, 0xff, 0xff, 0xff, 0xff, 0xff, 0xff, 0xff, 0xff, 0xff, 0xff, 0xff, 0xff, 0xff, 0xff
};
//endregion
enum {
    MENU_ADC,
    MENU_LED,
    MENU_RTC,
    MENU_FLASH,
    MENU_TF,
    MENU_INFO,
    MENU_SETTING,
    MENU_CUBE,
    MENU_NUM,
};

enum {
    STATE_SETUP,
    STATE_MENU,
    STATE_SUB_MENU,
    STATE_WINDOW,
    STATE_ON,
    STATE_OFF,
    STATE_POS_UP,
    STATE_POS_DOWN,
};

enum {
    DISP_BRI,     //屏幕亮度
    TILE_ANI,     //磁贴动画速度
    LIST_ANI,     //列表动画速度
    WIN_ANI,      //弹窗动画速度
    WIN_TIME,     //弹窗持续时间
    SPOT_ANI,     //聚光动画速度
    TAG_ANI,      //标签动画速度
    FADE_ANI,     //消失动画速度
    BTN_SPT,      //按键短按时长
    BTN_LPT,      //按键长按时长
    TILE_UFD,     //磁贴图标从头展开开关
    LIST_UFD,     //菜单列表从头展开开关
    TILE_LOOP,    //磁贴图标循环模式开关
    LIST_LOOP,    //菜单列表循环模式开关
    WIN_BOK,      //弹窗背景虚化开关
    KNOB_DIR,     //旋钮方向切换开关
    DARK_MODE,    //黑暗模式开关
    UI_PARAM,    //UI参数数量
};

typedef struct text {
    char *text;
} text;

typedef struct List {
    uint8_t index;
    uint8_t focus;
    uint8_t length;
    uint8_t state[32];
    uint8_t pos; // 确定在上方还是下方
    text *str;
} List;

struct tile {
    int16_t temp;
    bool select_flag;
    float icon_x;
    float icon_x_trg;
    float icon_y;
    float icon_y_trg;
    float indi_x;
    float indi_x_trg;
    float title_y;
    float title_y_trg;
} tile;

struct ui {
    bool init;
    bool clear;
    uint8_t index;
    uint8_t state;
    uint8_t param[UI_PARAM];
    List list[MENU_NUM];
} ui;

struct window {
    char *str;
    uint8_t state;
} window;

struct adc {
    uint32_t value;
    uint32_t offset;
    uint32_t buffer[80];
    float volt;
} adc;

struct timer {
    uint32_t start;
    uint8_t state;
};

text LED_text[] = {
        {"[ LED Controller ]"},
        {"+ LED1"},
        {"+ LED2"},
        {"+ LED3"},
        {"+ LED4"},
        {"+ LED5"},
        {"+ LED6"},
};

text Info_text[] = {
        {"[ Info ]"},
        {"- Version: v1.0"},
        {"- Board: GD32F470"},
        {"- Ram: 256k"},
        {"- Flash: 512k + 512k"},
        {"- Max Freq: 240Mhz"},
        {"- Author: Water_bros Zhou"},
};

List *list;

void animation(float *a, float *a_trg, uint8_t n) {
    if (*a != *a_trg) {
        if (fabs(*a - *a_trg) < 0.15f) *a = *a_trg;
        else *a += (*a_trg - *a) / (ui.param[n] / 10.0f);
    }
}

void ui_Param_Init(u8g2_t *u8g2) {
    ui.param[DISP_BRI] = 255;
    ui.param[WIN_TIME] = 3;

    adc.value = 0;
    adc.volt = 0;

    list = &ui.list[MENU_LED];
    list->length = 7;
    list->str = LED_text;
    list->index = 0;
    list->focus = 0;
    list->pos = STATE_POS_UP;

    list = &ui.list[MENU_INFO];
    list->length = sizeof(Info_text) / sizeof(text);
    list->str = Info_text;
    list->index = 0;
    list->focus = 0;
    list->pos = STATE_POS_UP;
}


void ui_Init(u8g2_t *u8g2) {
    tick = HAL_GetTick();

    ui.index = MENU_ADC;
    ui.state = STATE_MENU;
//    ui.state = STATE_SETUP;

    u8g2_Init(u8g2);
    u8g2_SetContrast(u8g2, ui.param[DISP_BRI]);
    ui_Param_Init(u8g2);
}

void Draw_Indicator(u8g2_t *u8g2) {
    u8g2_DrawBox(u8g2, 48, 0, 6, 1);
    u8g2_DrawBox(u8g2, 74, 0, 6, 1);
    u8g2_DrawBox(u8g2, 48, 31, 6, 1);
    u8g2_DrawBox(u8g2, 74, 31, 6, 1);

    u8g2_DrawBox(u8g2, 48, 0, 1, 6);
    u8g2_DrawBox(u8g2, 79, 0, 1, 6);
    u8g2_DrawBox(u8g2, 48, 26, 1, 6);
    u8g2_DrawBox(u8g2, 79, 26, 1, 6);
}


void Dark_Mode(u8g2_t *u8g2) {
    u8g2_SetDrawColor(u8g2, 2);
    if (ui.param[DARK_MODE]) u8g2_DrawBox(u8g2, 0, 0, DISP_W, DISP_H);
}

void LED_Output(uint8_t led, uint8_t state) {
    switch (state) {
        case STATE_ON:
            HAL_GPIO_WritePin(GPIOE, LED_Pins[led], GPIO_PIN_SET);
            break;
        case STATE_OFF:
            HAL_GPIO_WritePin(GPIOE, LED_Pins[led], GPIO_PIN_RESET);
            break;
    }
}

void List_Show(u8g2_t *u8g2) {
//    list = &ui.list[ui.index];

//    u8g2_SetFont(u8g2, u8g2_font_heisans_tr);
    u8g2_SetFont(u8g2, u8g2_font_HelvetiPixel_tr);
    u8g2_SetDrawColor(u8g2, 1);

    u8g2_DrawBox(u8g2, 123, 0, 5, (list->focus + 1) * 32 / list->length);
    u8g2_DrawHLine(u8g2, 123, 0, 5);
    u8g2_DrawHLine(u8g2, 123, 31, 5);
    u8g2_DrawVLine(u8g2, 125, 0, 32);


    for (uint8_t i = 0; i < list->length; i++) {
        u8g2_DrawStr(u8g2, 4, (i - list->index) * 16 + 12, list->str[i].text);

        switch (list->str[i].text[0]) {
            case '+':
                u8g2_SetDrawColor(u8g2, 1);
                u8g2_DrawFrame(u8g2, 104, (i - list->index) * 16 + 4, 8, 8);

                if (list->state[i] == STATE_ON) {
                    u8g2_DrawBox(u8g2, 106, (i - list->index) * 16 + 6, 4, 4);
                }
                break;
            default:
                break;
        }

        if (i == list->index && list->pos == STATE_POS_UP) {
            uint8_t w = u8g2_GetStrWidth(u8g2, list->str[list->focus].text);
            u8g2_SetDrawColor(u8g2, 2);
            u8g2_DrawRBox(u8g2, 0, 0, w + 8, 16, 4);
        } else if (i == list->focus && list->pos == STATE_POS_DOWN) {
            uint8_t w = u8g2_GetStrWidth(u8g2, list->str[list->focus].text);
            u8g2_SetDrawColor(u8g2, 2);
            u8g2_DrawRBox(u8g2, 0, 16, w + 8, 16, 4);
        }

    }

}

void Diagram_Show(u8g2_t *u8g2) {
    u8g2_SetDrawColor(u8g2, 1);
    u8g2_SetFont(u8g2, u8g2_font_HelvetiPixel_tr);

    u8g2_DrawHLine(u8g2, 0, 31, 82);
    u8g2_DrawVLine(u8g2, 0, 0, 32);

    for (uint8_t i = 0; i < 80; i++) {
        u8g2_DrawPixel(u8g2, 82 - i, adc.offset - adc.buffer[i]);
    }

    char volt[6];
    sprintf(volt, "%.2fV", adc.volt);
    uint8_t w = u8g2_GetStrWidth(u8g2, volt);
    u8g2_DrawFrame(u8g2, 86, 0, 42, 32);
    u8g2_DrawStr(u8g2, 86 + (42 - w) / 2, 20, volt);
}

void Window_Pop(u8g2_t *u8g2) {
    u8g2_SetDrawColor(u8g2, 0);
    u8g2_DrawRBox(u8g2, 12, 2, 104, 28, 4);
    u8g2_SetDrawColor(u8g2, 1);
    u8g2_DrawRFrame(u8g2, 14, 4, 100, 24, 4);

    uint8_t w = u8g2_GetUTF8Width(u8g2, window.str);
    u8g2_SetFont(u8g2, u8g2_font_HelvetiPixel_tr);
    u8g2_DrawStr(u8g2, (DISP_W - w) / 2, 20, window.str);
//    显示最后一页/第一页的文字

    if (HAL_GetTick() - tick >= ui.param[WIN_TIME] * 500) {
        tick = HAL_GetTick();
        ui.state = STATE_MENU;
    }
}


void Tile_Show(u8g2_t *u8g2) {
    tile.icon_x = (float) -(ui.index * 32) + 50;

//    animation(&tile.icon_x, &tile.icon_x_trg, TILE_ANI);
//    animation(&tile.icon_y, &tile.icon_y_trg, TILE_ANI);
//    animation(&tile.indi_x, &tile.indi_x_trg, TILE_ANI);

    u8g2_SetDrawColor(u8g2, 1);
    if (ui.state != STATE_WINDOW) {
        Draw_Indicator(u8g2);
    }

    for (uint8_t i = 0; i < MENU_NUM; i++) {
        u8g2_DrawXBMP(u8g2, (i - ui.index) * 32 + 50, 2, TILE_ICON_W,
                      TILE_ICON_H, main_icons[i]);
    }
}

void ADC_Proc(u8g2_t *u8g2) {
    HAL_ADC_Start_IT(&hadc1);
    adc.value = HAL_ADC_GetValue(&hadc1);
    adc.volt = (adc.value * 3.3f) / 4096.0f;
    adc.buffer[0] = adc.value / 10;
    adc.offset = adc.buffer[0] > adc.offset ? adc.buffer[0] : adc.offset;
    adc.offset = adc.offset - adc.buffer[0] > 31 ? adc.buffer[0] + 31 : adc.offset;

    for (uint8_t i = 79; i > 0; i--) {
        adc.buffer[i] = adc.buffer[i - 1];
    }

    Diagram_Show(u8g2);
}

void LED_Proc(u8g2_t *u8g2) {
    list = &ui.list[MENU_LED];
    List_Show(u8g2);

    for (uint8_t led = 0; led < list->length - 1; led++) {
        LED_Output(led, list->state[led + 1]);
    }
}

void RTC_Proc(u8g2_t *u8g2) {}

void Flash_Proc(u8g2_t *u8g2) {}

void TF_Proc(u8g2_t *u8g2) {}

void Info_Proc(u8g2_t *u8g2) {
    list = &ui.list[MENU_INFO];
    List_Show(u8g2);
}

void Setting_Proc(u8g2_t *u8g2) {}

void Cube_Proc(u8g2_t *u8g2) {
    u8g2_SetDrawColor(u8g2, 1);
    u8g2_SetFont(u8g2, u8g2_font_HelvetiPixel_tr);

    char time[8];
    uint32_t t = HAL_GetTick() - tick;
    sprintf(time, "%d.%d", t / 1000, t % 1000);
    u8g2_DrawStr(u8g2, 0, 10, time);
}

void ui_Proc(u8g2_t *u8g2) {
    switch (ui.state) {
        case STATE_SETUP:
            Genshin(u8g2);
            break;
        case STATE_MENU:
            Tile_Show(u8g2);
            break;
        case STATE_WINDOW:
            Tile_Show(u8g2);
            Window_Pop(u8g2);
            break;
        case STATE_SUB_MENU:
            if (!ui.clear) {
                ui.clear = true;
                u8g2_SetDrawColor(u8g2, 0);
                u8g2_DrawBox(u8g2, 0, 0, DISP_W, DISP_H); // 清屏
            }
            switch (ui.index) {
                case MENU_ADC:
                    ADC_Proc(u8g2);
                    break;
                case MENU_LED:
                    LED_Proc(u8g2);
                    break;
                case MENU_RTC:
                    RTC_Proc(u8g2);
                    break;
                case MENU_FLASH:
                    Flash_Proc(u8g2);
                    break;
                case MENU_TF:
                    TF_Proc(u8g2);
                    break;
                case MENU_INFO:
                    Info_Proc(u8g2);
                    break;
                case MENU_SETTING:
                    Setting_Proc(u8g2);
                    break;
                case MENU_CUBE:
//                    Cube_Proc(u8g2);
                    break;
            }
            break;
    }

    Dark_Mode(u8g2);
}

void Scan_Key(void) {
    for (uint8_t i = 0; i < 6; i++) {
        if (HAL_GPIO_ReadPin(GPIOD, KEY_Pins[i]) == GPIO_PIN_SET) {
//            LED_Output(i);
            HAL_Delay(70);
            if (HAL_GPIO_ReadPin(GPIOD, KEY_Pins[i]) == GPIO_PIN_SET) {
//                tick_key = HAL_GetTick();
                /* 扫描按键状态机 */
                switch (i) {
                    case 0:
                        switch (ui.state) {
                            case STATE_MENU:
                                ui.index--;
                                if (ui.index == 255) {
                                    ui.index = MENU_ADC;
                                    ui.state = STATE_WINDOW;
                                    window.str = "First Page";
                                    tick = HAL_GetTick();
                                }
                                break;
                            case STATE_SUB_MENU:
                                list = &ui.list[ui.index];
                                switch (list->pos) {
                                    case STATE_POS_DOWN:
                                        list->pos = STATE_POS_UP;
                                        list->focus = list->index;
                                        break;
                                    case STATE_POS_UP:
                                        list->index--;
                                        if (list->index == 255) {
                                            list->index = 0;
                                        }
                                        list->focus = list->index;
                                        break;
                                }
                                break;
                            case STATE_WINDOW:
                                break;
                        }
                        break;
                    case 1:
                        switch (ui.state) {
                            case STATE_MENU:
                                ui.index++;
                                if (ui.index >= MENU_NUM) {
                                    ui.index = MENU_NUM - 1;
                                    ui.state = STATE_WINDOW;
                                    window.str = "Last Page";
                                    tick = HAL_GetTick();
                                }
                                break;
                            case STATE_SUB_MENU:
                                list = &ui.list[ui.index];
                                switch (list->pos) {
                                    case STATE_POS_UP:
                                        list->pos = STATE_POS_DOWN;
                                        list->focus = list->index + 1;
                                        break;
                                    case STATE_POS_DOWN:
                                        list->index++;
                                        if (list->index == list->length - 1) {
                                            list->index = list->length - 2;
                                        }
                                        list->focus = list->index + 1;
                                        break;
                                }
                                break;
                            case STATE_WINDOW:
                                break;
                        }
                        break;
                    case 2:
                        switch (ui.state) {
                            case STATE_MENU:
                                ui.state = STATE_SUB_MENU;
                                break;
                            case STATE_SUB_MENU:
                                switch (list->str[list->focus].text[0]) {
                                    case '+':
                                        switch (list->state[list->focus]) {
                                            case STATE_ON:
                                                list->state[list->focus] = STATE_OFF;
                                                break;
                                            default:
                                                list->state[list->focus] = STATE_ON;
                                                break;
                                        }
                                        break;
                                    case '-':
                                        break;
                                }
                                break;
                            case STATE_WINDOW:
                                break;
                        }
                        break;
                    case 3:
                        switch (ui.state) {
                            case STATE_MENU:
                                break;
                            case STATE_SUB_MENU:
                                ui.state = STATE_WINDOW;
                                ui.clear = false;
                                window.str = "Save !";
                                tick = HAL_GetTick();
                                // 保存设置到Flash
                                break;
                            case STATE_WINDOW:
                                break;
                        }
                    case 4:
                        break;
                    case 5:
                        ui.param[DARK_MODE] = !ui.param[DARK_MODE];
                        break;
                }
            }
        }
    }
}

void Genshin(u8g2_t *u8g2) {
    u8g2_SetDrawColor(u8g2, 1);
    u8g2_DrawXBMP(u8g2, 0, 0, 128, 32, genshin);
    if (HAL_GetTick() - tick >= 5000) {
        ui.state = STATE_MENU;
    }
}